## defconfig
```kconfig
BR2_mips=y
BR2_mips_32=y
BR2_TOOLCHAIN_EXTERNAL=y
BR2_TOOLCHAIN_EXTERNAL_CUSTOM=y
BR2_TOOLCHAIN_EXTERNAL_PATH="$(TOPDIR)/sagem/uclibc-crosstools-gcc-4.2.3-3/usr"
BR2_TOOLCHAIN_EXTERNAL_CUSTOM_PREFIX="mips-linux-uclibc"
BR2_TOOLCHAIN_EXTERNAL_INET_IPV6=y
# BR2_TOOLCHAIN_EXTERNAL_HAS_THREADS_DEBUG is not set
BR2_TOOLCHAIN_EXTERNAL_INET_RPC=y
BR2_TARGET_GENERIC_HOSTNAME=""
BR2_ROOTFS_STATIC_DEVICE_TABLE=""
BR2_ROOTFS_SKELETON_CUSTOM=y
BR2_ROOTFS_SKELETON_CUSTOM_PATH="$(TOPDIR)/sagem/rootfs-skeleton"
BR2_ROOTFS_OVERLAY="$(TOPDIR)/sagem/rootfs-overlay"
BR2_ROOTFS_POST_IMAGE_SCRIPT="$(TOPDIR)/sagem/fakeroot_build.sh"
BR2_PACKAGE_LZO=y
BR2_PACKAGE_DNSMASQ=y
# BR2_PACKAGE_DNSMASQ_TFTP is not set
BR2_PACKAGE_DROPBEAR=y
BR2_PACKAGE_IPTABLES=y
```
